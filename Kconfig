## Kconfig
```kconfig
menu "Smartknob-HA SDK Configuration"
	
	choice WiFi Settings
		config WIFI_AP_MODE
            bool "WiFi access point mode?"
        config WIFI_SSID
            string "WiFi SSID"
        config WIFI_PASSWD
            string "WiFi Password"
	endchoice
endmenu
```

## config/Kconfig
```kconfig
menu "Smartknob-HA SDK Config"
    rsource "../manager/config"
    rsource "../wifi/config"
    rsource "../network_manager/config"
    rsource "../http_server/config"
endmenu
```

## disp_driver/kconfig
```kconfig
menu "Smartknob-HA Components"

    menu "Display"
        config DISPLAY_FRAME_BUFFER_PSRAM
            bool "Should the frame buffer be in PSRAM"

        config LVGL_TICK_RATE
            int "How often should the timer run in ms"
            default 1

    endmenu

endmenu
```

## led_strip/Kconfig
```kconfig
menu "Smartknob-HA Components"

    menu "LED Strip"

        config LED_STRIP_GPIO
            int "GPIO number for LED data"
            default 17
        config LED_STRIP_NUM
            int "Number of LED's in strip"
            default 8
        config LED_RMT_CHANNEL
            int "What RMT channel to use for the LED's"
            default 0
    endmenu
endmenu
```

## wifi_ap/kconfig
```kconfig
menu "Smartknob-HA Components"

    menu "Wifi AP"

        config AP_CHANNEL
            int "AP Channel to use"
            default 10

        config AP_MAX_CONNECTIONS
            int "Max connections to AP"
            default 2

    endmenu

endmenu
```

## wifi_sta/kconfig
```kconfig
menu "Smartknob-HA Components"

    menu "Wifi STA"

        config DEFAULT_HOSTNAME
            string "Default hostname"
            default "Smartknob"
    endmenu

endmenu
```

## wifi_station/Kconfig
```kconfig
menu "Smartknob-HA Components"

    menu "Wifi Station"

        config STATION_CREDENTIALS_FROM_KCONFIG
            bool "Station Credentials from KConfig"
            default false
            help
                Select this if the SSID and password should be taken from KConfig

        config STATION_SSID
            string "STATION SSID"
            depends on STATION_CREDENTIALS_FROM_KCONFIG

        config STATION_PASSWORD
            string "STATION Password"
            depends on STATION_CREDENTIALS_FROM_KCONFIG

        config STATION_MAXIMUM_RETRY
            int "Max connection retries"
            default 5

        choice MINIMUM_STATION_SECURITY
            depends on STATION_CREDENTIALS_FROM_KCONFIG
            prompt "Station security standard threshold"
            default ESP_WIFI_AUTH_WPA2_WPA3_PSK
            help
                Determine minimum security for WiFi station mode
                - WiFi Auth OPEN
                - WiFi Auth WEP
                - WiFi Auth WPA_PSK
                - WiFi Auth WPA2_PSK
                - WiFi Auth WPA_WPA2_PSK
                - WiFi Auth WPA3_PSK
                - WiFi Auth WPA2_WPA3_PSK
                - WiFi Auth WAPI_PSK
            config ESP_WIFI_AUTH_OPEN
                bool "Open"
            config ESP_WIFI_AUTH_WEP
                bool "WEP"
            config ESP_WIFI_AUTH_WPA_PSK
                bool "WPA-PSK"
            config ESP_WIFI_AUTH_WPA2_PSK
                bool "WPA2-PSK"
            config ESP_WIFI_AUTH_WPA_WPA2_PSK
                bool "WPA/WPA2-PSK"
            config ESP_WIFI_AUTH_WPA3_PSK
                bool "WPA3-PSK"
            config ESP_WIFI_AUTH_WPA2_WPA3_PSK
                bool "WPA2/3-PSK"
            config ESP_WIFI_AUTH_WAPI_PSK
                bool "WAPI-PSK"
        endchoice

    endmenu

endmenu

#Message #firmware
```
